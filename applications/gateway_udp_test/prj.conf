## CMakeLists.txt
```
# SPDX-License-Identifier: Apache-2.0

cmake_minimum_required(VERSION 3.20.0)

find_package(Zephyr REQUIRED HINTS $ENV{ZEPHYR_BASE})
project(gateway_udp_test)

target_include_directories(app PRIVATE include)
target_sources(app PRIVATE
  src/main.c
  src/udp.c
  src/persist.c
  src/shell.c
)
```

## Kconfig
```
# SPDX-License-Identifier: Apache-2.0
# gateway_udp_test application configuration

mainmenu "gateway_udp_test"

source "Kconfig.zephyr"

config GUT_DATA_RX_STACK
	int "UDP data RX thread stack size"
	default 1024

config GUT_DATA_RX_PRIORITY
	int "UDP data RX thread priority"
	default 10

config GUT_UDP_INIT_PRIORITY
	int "UDP app handler init priority (must run before udp_fw_upgrade lib)"
	default 80
```

## sysbuild.conf
```
SB_CONFIG_BOOTLOADER_MCUBOOT=y
SB_CONFIG_MCUBOOT_MODE_SWAP_SCRATCH=y
SB_CONFIG_BOOT_SIGNATURE_KEY_FILE="${APP_DIR}/boards/rsa_mcuboot_2048.pem"
```

## prj.conf
```kconfig
CONFIG_MAIN_STACK_SIZE=2048

# shell
CONFIG_SHELL=y
CONFIG_SERIAL=y
CONFIG_GPIO=y
CONFIG_LOG=y
CONFIG_LOG_DEFAULT_LEVEL=3
CONFIG_LOG_BUFFER_SIZE=4096
CONFIG_LOG_BLOCK_IN_THREAD=y

# Networking
CONFIG_NETWORKING=y
CONFIG_NET_IPV4=y
CONFIG_NET_UDP=y
CONFIG_NET_SOCKETS=y
CONFIG_POSIX_API=y
CONFIG_NET_L2_ETHERNET=y
CONFIG_NET_ARP=y
CONFIG_NET_MGMT=y
CONFIG_NET_MGMT_EVENT=y
CONFIG_NET_DHCPV4=y       /* DHCP 客户端 (静态/DHCP 模式切换) */
CONFIG_NET_STATISTICS=y

# Entropy (STM32F407 硬件 RNG)
CONFIG_ENTROPY_GENERATOR=y

# SPI Flash (W25Q128, MCUBoot slot1/scratch + cfg 分区)
CONFIG_FLASH=y
CONFIG_SPI=y
CONFIG_SPI_NOR_SFDP_MINIMAL=n
CONFIG_SPI_NOR_FLASH_LAYOUT_PAGE_SIZE=4096
CONFIG_FLASH_MAP=y
CONFIG_IMG_MANAGER=y
CONFIG_STREAM_FLASH=y
CONFIG_REBOOT=y

# CRC
CONFIG_CRC=y

# UDP firmware upgrade library (self-contained: owns config port 9200)
CONFIG_UDP_FW_UPGRADE=y
CONFIG_UDP_FW_RX_STACK_SIZE=1536

# Settings persistent storage (FCB backend, cfg_partition)
CONFIG_SETTINGS=y
CONFIG_SETTINGS_RUNTIME=y
CONFIG_FCB=y

# MCUBoot bootutil (image info)
CONFIG_BOOTLOADER_MCUBOOT=y
CONFIG_NET_PKT_RX_COUNT=4
CONFIG_NET_PKT_TX_COUNT=4
CONFIG_NET_BUF_RX_COUNT=8
CONFIG_NET_BUF_TX_COUNT=8
# 固件升级 512B 包需 4 个 buf, 8 个够; DATA_SIZE 保持默认 128
CONFIG_NET_BUF_DATA_SIZE=128
# 2 socket + DHCP 占 1, 4 足够
CONFIG_NET_MAX_CONN=4
CONFIG_TEST_RANDOM_GENERATOR=y
```

## boards/stm32f407_xinxin.overlay
```dts
/*
 * gateway_udp_test board overlay for stm32f407_xinxin
 *
 * 硬件: STM32F407 内置 MAC + 外部 PHY (RMII), 由 f407-mac snippet 启用.
 * 板级 DTS 已定义 MCUBoot flash 分区 (mcuboot/slot0 内部 flash,
 * slot1/scratch/cfg 外部 W25Q128). 本 overlay 仅指定 settings 分区.
 */

/ {
	chosen {
		zephyr,settings-partition = &cfg_partition;
	};
};
```

## src/main.c
```c
/*
 * Copyright (c) 2026 Kabirz.
 * SPDX-License-Identifier: Apache-2.0
 *
 * gateway UDP 测试应用 — 主入口
 * 初始化静态 IP, 启动 UDP 双端口线程 (线程在 udp.c 中 K_THREAD_DEFINE)
 *
 * 平移自 gateway/src/main.c, 去掉 swd_recover (F1 专属) 和 RF24 初始化.
 *
 * 网络就绪同步: STM32F407 内置 MAC 接口注册晚于 main 启动, 故先注册
 * NET_EVENT_IF_UP 回调, 轮询等待接口出现后配置静态 IP 并 net_if_up, 再用
 * 信号量等接口 oper state UP. 这替代原先固定 k_msleep(500) 的盲等待.
 */

#include <string.h>
#include <zephyr/kernel.h>
#include <zephyr/settings/settings.h>
#include <zephyr/app_version.h>
#include <zephyr/net/net_if.h>
#include <zephyr/net/socket.h>
#include <zephyr/net/net_mgmt.h>
#include <zephyr/net/net_event.h>
#include <zephyr/net/dhcpv4.h>
#include <gateway_udp_test.h>
#ifndef CONFIG_FLASH_SIZE
#define CONFIG_FLASH_SIZE 0x1000
#endif


#include <zephyr/logging/log.h>
LOG_MODULE_REGISTER(gut_main, LOG_LEVEL_INF);

gut_params_t gut_params;

/* ================================================================
 * 网络链路就绪同步
 * ================================================================
 * 内置 MAC 驱动在 POST_KERNEL 阶段注册网络接口并初始化 PHY; PHY 检测到载波
 * 后 net_eth_carrier_on → oper state UP → notify_iface_up 发出 NET_EVENT_IF_UP.
 * 用信号量捕获该事件, 通知 UDP 线程接口已可用. */
static K_SEM_DEFINE(net_link_sem, 0, 1);

/* 网络链路状态: IF_UP 置 true, IF_DOWN 置 false. gut_udp_send 据此决定是否转发. */
volatile bool gut_net_link_up;

/* 网络事件回调 (静态注册, 编译时进 section, 不受运行时注册时序影响).
 * 注意: Zephyr net_mgmt 的 mask 匹配按 layer 精确相等, 不同 layer 的事件
 * (IF_UP=L2, IPV4_ADDR_ADD=L3) 不能 OR 在同一个 mask 里, 否则全部匹配失败.
 * 故分成两个独立 handler 注册. IF_UP/IF_DOWN 同 layer 可共用一个. */

/* IF_UP/IF_DOWN: carrier 状态变化 → 唤醒 main + 启动 DHCP + 维护 gut_net_link_up. */
static void net_if_event_handler(uint64_t mgmt_event, struct net_if *iface,
				 void *info, size_t info_length, void *user_data)
{
	ARG_UNUSED(info);
	ARG_UNUSED(info_length);
	ARG_UNUSED(user_data);

	if (mgmt_event == NET_EVENT_IF_UP) {
		LOG_INF("net link up");
		gut_net_link_up = true;
		k_sem_give(&net_link_sem);
		/* DHCP 模式: carrier up 后才启动 DHCP 客户端 (启动早了 Discover 发不出) */
		if (gut_params.use_dhcp) {
			LOG_INF("Starting DHCPv4 client...");
			net_dhcpv4_start(iface);
		}
	} else if (mgmt_event == NET_EVENT_IF_DOWN) {
		LOG_WRN("net link down");
		gut_net_link_up = false;
	}
}

/* ADDR_ADD: IPv4 地址分配完成 → 打印 IP/掩码/网关 (DHCP 模式额外打印租期). */
static void net_ipv4_event_handler(uint64_t mgmt_event, struct net_if *iface,
				   void *info, size_t info_length, void *user_data)
{
	ARG_UNUSED(info);
	ARG_UNUSED(info_length);
	ARG_UNUSED(user_data);

	if (mgmt_event != NET_EVENT_IPV4_ADDR_ADD) {
		return;
	}
	for (int i = 0; i < NET_IF_MAX_IPV4_ADDR; i++) {
		if (iface->config.ip.ipv4->unicast[i].ipv4.addr_type !=
		    NET_ADDR_DHCP && iface->config.ip.ipv4->unicast[i].ipv4.addr_type !=
		    NET_ADDR_MANUAL) {
			continue;
		}
		char buf[NET_IPV4_ADDR_LEN];

		net_addr_ntop(AF_INET,
			      &iface->config.ip.ipv4->unicast[i].ipv4.address.in_addr,
			      buf, sizeof(buf));
		LOG_INF("IPv4 address: %s", buf);
		net_addr_ntop(AF_INET, &iface->config.ip.ipv4->unicast[i].netmask,
			      buf, sizeof(buf));
		LOG_INF("IPv4 netmask: %s", buf);
		net_addr_ntop(AF_INET, &iface->config.ip.ipv4->gw, buf, sizeof(buf));
		LOG_INF("IPv4 gateway: %s", buf);
		if (iface->config.ip.ipv4->unicast[i].ipv4.addr_type == NET_ADDR_DHCP) {
			LOG_INF("DHCP lease time: %u seconds", iface->config.dhcpv4.lease_time);
		}
		break;
	}
}

NET_MGMT_REGISTER_EVENT_HANDLER(net_if_handler_cb,
				NET_EVENT_IF_UP | NET_EVENT_IF_DOWN,
				net_if_event_handler, NULL);
NET_MGMT_REGISTER_EVENT_HANDLER(net_ipv4_handler_cb, NET_EVENT_IPV4_ADDR_ADD,
				net_ipv4_event_handler, NULL);

/* ================================================================
 * 网络初始化 (静态 IP / DHCP)
 * ================================================================
 * 调用前提: iface 已注册 (由 main 轮询等待). 事件回调已静态注册 (编译时).
 * DHCP 模式下 net_dhcpv4_start 延迟到 NET_EVENT_IF_UP 回调里调用. */
static int net_init(struct net_if *iface)
{
	if (gut_params.use_dhcp) {
		/* DHCP 模式: 只 up 接口, DHCP 客户端在 IF_UP 回调里启动 */
		LOG_INF("DHCP mode, waiting for link up...");
		net_if_up(iface);
	} else {
		/* 静态模式: 掩码固定 /24; 网关 = IP 末段改 1 (a.b.c.1), 不存储 */
		struct in_addr addr, mask, gw;

		if (net_addr_pton(AF_INET, gut_params.ip_addr, &addr) < 0) {
			LOG_ERR("Invalid IP address: %s", gut_params.ip_addr);
			return -EINVAL;
		}
		mask.s_addr = htonl(0xFFFFFF00);
		memcpy(&gw, &addr, sizeof(gw));
		((uint8_t *)&gw.s_addr)[3] = 1;

		net_if_ipv4_addr_add(iface, &addr, NET_ADDR_MANUAL, 0);
		net_if_ipv4_set_netmask_by_addr(iface, &addr, &mask);
		net_if_ipv4_set_gw(iface, &gw);

		net_if_up(iface);

		char gw_str[NET_IPV4_ADDR_LEN];
		net_addr_ntop(AF_INET, &gw, gw_str, sizeof(gw_str));
		LOG_INF("Network: %s/24 gw %s", gut_params.ip_addr, gw_str);
	}
	return 0;
}

int main(void)
{
	LOG_INF("build time: %s-%s", __DATE__, __TIME__);
	LOG_INF("board: %s, system clk: %dMHz", CONFIG_BOARD_TARGET,
		CONFIG_SYS_CLOCK_HW_CYCLES_PER_SEC / MHZ(1));
	LOG_INF("flash size: %dKB, ram size: %dKB", CONFIG_FLASH_SIZE, CONFIG_SRAM_SIZE);
	LOG_INF("version: %s", APP_VERSION_STRING);

	/* 初始化默认配置 */
	gut_params.rf24_channel = RF24_DEFAULT_CH;
	memset(gut_params.rf24_addr, 0, RF24_ADDR_LEN);
	strncpy(gut_params.ip_addr, GUT_DEFAULT_IP, sizeof(gut_params.ip_addr) - 1);
	gut_params.data_port = GUT_DATA_PORT_DEFAULT;
	gut_params.use_dhcp = GUT_USE_DHCP_DEFAULT;
	gut_params.echo = false;
	k_event_init(&gut_params.event);

	/* 加载持久化配置 (覆盖默认值) */
	settings_load();

	/* 等待内置 MAC 接口注册 (POST_KERNEL 驱动 init, 晚于 main 启动).
	 * 轮询 net_if_get_default 直到接口出现, 带超时兜底避免永久阻塞. */
	struct net_if *iface = NULL;

	for (int i = 0; i < 100; i++) {
		iface = net_if_get_default();
		if (iface != NULL) {
			break;
		}
		k_msleep(50);
	}
	if (iface == NULL) {
		LOG_ERR("No network interface found (check ETH driver/PHY)");
		/* 不 set event: UDP 线程持续等待, 避免在无接口状态下 bind 报错刷屏 */
	} else {
		int ret = net_init(iface);

		if (ret != 0) {
			LOG_ERR("net_init failed: %d", ret);
		} else {
			/* 等 PHY 链路 up: 若注册回调时 oper state 已 UP 则跳过;
			 * 否则等 NET_EVENT_IF_UP 信号量, 带超时兜底 (网线未插时不永久阻塞,
			 * UDP 线程链路恢复后自然恢复转发). */
			if (net_if_oper_state(iface) != NET_IF_OPER_UP) {
				if (k_sem_take(&net_link_sem, K_SECONDS(5)) != 0) {
					LOG_WRN("net link up timeout, continue anyway");
				}
			}
			/* 唤醒 UDP 线程, 它们此刻才开始创建 socket 并 bind */
			k_event_set(&gut_params.event, 0x1);
		}
	}

	gut_params.running = true;
	LOG_INF("gateway_udp_test ready (data:%d config:%d)", gut_params.data_port,
		CONFIG_UDP_FW_CONFIG_PORT);

	while (1) {
		k_sleep(K_MSEC(1000));
	}

	return 0;
}
```

## include/gateway_udp_test.h
```c
/*
 * Copyright (c) 2026 Kabirz.
 * SPDX-License-Identifier: Apache-2.0
 *
 * gateway UDP 测试应用 — 公共定义
 * 从 gateway 平移网络/UDP 功能, 去掉 nRF24 无线部分。
 */

#ifndef __GATEWAY_UDP_TEST_H__
#define __GATEWAY_UDP_TEST_H__

#include <zephyr/kernel.h>
#include <zephyr/net/net_ip.h>
#include <stdbool.h>
#include <stdint.h>

/* ================================================================
 * 帧 ID (数据端口数据帧格式 [帧 ID 2B BE][payload])
 * 复用 gateway 历史 CAN 11-bit 编号作逻辑标识符, 与上位机协议兼容
 * ================================================================ */
enum can_ids {
	COBID_HEATBEAT = 0x763,
	TEST_FRAME = 0x777,
	HANDLER_STATE = 0x1E3,
	OVERBREAK_LASER = 0x263,
	COORD_XY = 0x363,
	COORD_Z = 0x463,
};

/* ================================================================
 * RF24 地址/信道配置 (无 nRF24 硬件, 仅用于协议验证/持久化,
 * 字段与 gateway 保持一致以便统一上位机测试)
 * ================================================================ */
#define RF24_ADDR_LEN    5
#define RF24_ADDR_MAX_CH 125
#define RF24_DEFAULT_CH  76

/* UDP 配置命令 (由 udp_fw_upgrade 库 RX 线程分发到 app_cmd_handler).
 * 0x01-0x05 由库内部处理 (FW_START/DATA/END/GET_VERSION/REBOOT), 不会到达此处.
 * 静态模式下掩码固定 255.255.255.0, 网关 = IP 末段改 1 (a.b.c.1), 均不在帧中传输.
 * DHCP 模式下 IP/掩码/网关由 DHCP 服务器分配, GET_NET 回复 live interface 地址. */
enum udp_cmd {
	UDP_CMD_SET_NET  = 0x12,   /* [ip 4B][port 2B BE] = 6B → 回显同序 6B */
	UDP_CMD_GET_NET  = 0x13,   /* (空) → [ip 4B][port 2B BE] = 6B (IP 取自 live interface) */
	UDP_CMD_SET_RF24 = 0x14,   /* [ch 1B][addr 5B] = 6B → 回显同序 6B */
	UDP_CMD_GET_RF24 = 0x15,   /* (空) → [ch 1B][addr 5B] = 6B */
	UDP_CMD_SET_NET_MODE = 0x16, /* [mode 1B] (0=静态,1=DHCP) → 回显 1B (持久化, 重启生效) */
	UDP_CMD_GET_NET_MODE = 0x17, /* (空) → [mode 1B] */
};

/* ================================================================
 * 网络默认配置
 * 静态模式: 掩码固定 255.255.255.0, 网关 = IP 末段改 1 (运行时派生, 不存储)
 * DHCP 模式: IP/掩码/网关由 DHCP 服务器分配
 * ================================================================ */
#define GUT_DEFAULT_IP         "192.168.11.220"
#define GUT_DATA_PORT_DEFAULT  9600  /* 数据端口 (可配, UDP_CMD_SET_NET) */
#define GUT_USE_DHCP_DEFAULT   0     /* 默认静态 IP (0=静态, 1=DHCP) */

/* ================================================================
 * 全局状态
 * ================================================================ */
typedef struct {
	/* RF24 配置 (无硬件, 仅协议验证用) */
	uint8_t rf24_channel;
	uint8_t rf24_addr[RF24_ADDR_LEN];

	/* 网络配置 (静态模式下掩码固定 /24, 网关由 IP 派生, 均不存储;
	 *           DHCP 模式下 IP/掩码/网关由 DHCP 分配) */
	char ip_addr[16];     /* 静态 IP (DHCP 模式下仅作 fallback) */
	uint16_t data_port;   /* 数据端口 (可配, 默认 GUT_DATA_PORT_DEFAULT) */
	uint8_t use_dhcp;     /* 0=静态 IP, 1=DHCP (持久化, 重启生效) */

	/* 运行状态 */
	volatile bool running;
	bool echo;            /* 数据端口回显开关 (shell 控制) */
	bool log;             /* UDP 收发详细日志开关 (shell: gut log [0/1]) */
	struct k_event event;
} gut_params_t;

extern gut_params_t gut_params;

/* 网络链路状态 (main.c 的 NET_EVENT_IF_UP/DOWN 回调维护).
 * gut_udp_send 据此决定是否转发数据到上位机. */
extern volatile bool gut_net_link_up;

/* ================================================================
 * 接口声明
 * ================================================================ */

/* udp.c */
void gut_udp_send(const uint8_t *data, size_t len);

/* 取本机 live IPv4 地址 (DHCP 分配或静态配置的当前地址), 失败返回 NULL.
 * DHCP 模式下 gut_params.ip_addr 是旧静态值, 需从 live interface 读. */
struct in_addr *gut_get_live_ipv4(void);

/* persist.c */
void persist_save_network_config(void);
void persist_save_rf24_config(void);

#endif /* __GATEWAY_UDP_TEST_H__ */
```

## src/persist.c
```c
/*
 * Copyright (c) 2026 Kabirz.
 * SPDX-License-Identifier: Apache-2.0
 *
 * Settings 持久化存储 — 使用 Zephyr settings 子系统 (FCB 后端, cfg_partition)
 * 平移自 gateway/src/persist.c; 保留 RF24 字段用于协议验证 (无硬件, 仅持久化).
 */

#include <zephyr/kernel.h>
#include <zephyr/settings/settings.h>
#include <zephyr/logging/log.h>
#include <gateway_udp_test.h>

LOG_MODULE_REGISTER(gut_persist, LOG_LEVEL_INF);

static int gut_persist_set(const char *name, size_t len, settings_read_cb read_cb, void *cb_arg)
{
	const char *next;
	size_t name_len = settings_name_next(name, &next);

	if (!next && !strncmp(name, "rf24_channel", name_len)) {
		if (len == sizeof(uint8_t)) {
			uint8_t ch;

			read_cb(cb_arg, &ch, sizeof(ch));
			if (ch <= RF24_ADDR_MAX_CH) {
				gut_params.rf24_channel = ch;
			}
		}
		return 0;
	}

	if (!next && !strncmp(name, "rf24_addr", name_len)) {
		if (len == RF24_ADDR_LEN) {
			read_cb(cb_arg, gut_params.rf24_addr, RF24_ADDR_LEN);
		}
		return 0;
	}

	if (!next && !strncmp(name, "ip_addr", name_len)) {
		if (len < sizeof(gut_params.ip_addr)) {
			read_cb(cb_arg, gut_params.ip_addr, len);
			gut_params.ip_addr[len] = '\0';
		}
		return 0;
	}

	if (!next && !strncmp(name, "data_port", name_len)) {
		if (len == sizeof(uint16_t)) {
			read_cb(cb_arg, &gut_params.data_port, sizeof(uint16_t));
		}
		return 0;
	}

	if (!next && !strncmp(name, "use_dhcp", name_len)) {
		if (len == sizeof(uint8_t)) {
			read_cb(cb_arg, &gut_params.use_dhcp, sizeof(uint8_t));
		}
		return 0;
	}

	return -ENOENT;
}

static int gut_persist_export(int (*cb)(const char *name, const void *value, size_t val_len))
{
	(void)cb("gut/rf24_channel", &gut_params.rf24_channel, sizeof(gut_params.rf24_channel));
	(void)cb("gut/rf24_addr", gut_params.rf24_addr, RF24_ADDR_LEN);
	(void)cb("gut/ip_addr", gut_params.ip_addr, strlen(gut_params.ip_addr));
	(void)cb("gut/data_port", &gut_params.data_port, sizeof(gut_params.data_port));
	(void)cb("gut/use_dhcp", &gut_params.use_dhcp, sizeof(gut_params.use_dhcp));
	return 0;
}

SETTINGS_STATIC_HANDLER_DEFINE(gut_persist, "gut", NULL, gut_persist_set, NULL,
			       gut_persist_export);

static int settings_backend_init(void)
{
	int rc = settings_subsys_init();

	if (rc) {
		LOG_ERR("settings_subsys_init failed: %d", rc);
	} else {
		LOG_INF("Settings subsystem initialized");
		/* 清除旧协议残留的历史键 (掩码/网关已不再持久化).
		 * 不删除的话 settings_load 回放时会打 -ENOENT 错误日志. */
		settings_delete("gut/netmask");
		settings_delete("gut/gateway");
	}
	return rc;
}

void persist_save_rf24_config(void)
{
	settings_save_one("gut/rf24_channel", &gut_params.rf24_channel,
			  sizeof(gut_params.rf24_channel));
	settings_save_one("gut/rf24_addr", gut_params.rf24_addr, RF24_ADDR_LEN);
	LOG_INF("Saved rf24: addr=%02x%02x%02x%02x%02x",
			gut_params.rf24_addr[0], gut_params.rf24_addr[1], gut_params.rf24_addr[2],
			gut_params.rf24_addr[3], gut_params.rf24_addr[4]);
}

void persist_save_network_config(void)
{
	settings_save_one("gut/ip_addr", gut_params.ip_addr, strlen(gut_params.ip_addr));
	settings_save_one("gut/data_port", &gut_params.data_port, sizeof(gut_params.data_port));
	settings_save_one("gut/use_dhcp", &gut_params.use_dhcp, sizeof(gut_params.use_dhcp));
	LOG_INF("Saved network: ip=%s port=%d dhcp=%d", gut_params.ip_addr, gut_params.data_port,
		gut_params.use_dhcp);
}

SYS_INIT(settings_backend_init, APPLICATION, 10);
```

## src/shell.c
```c
/*
 * Copyright (c) 2026 Kabirz.
 * SPDX-License-Identifier: Apache-2.0
 *
 * UDP 测试 shell 命令 — 模拟数据源, 验证 UDP 双端口链路
 *
 *   gut info              查看网络配置 (IP/掩码固定/网关/端口/RF24)
 *   gut send <id> <hex..> 发送数据帧 [帧ID 2B BE][payload]
 *   gut ping [count=5]    发送 TEST_FRAME (0x777) 计数测试
 *   gut echo [on|off]     开关数据端口回显
 *   gut ip <addr>         设置 IP (并持久化)
 *   gut port <port>       设置数据端口 (并持久化)
 */

#ifdef CONFIG_SHELL

#include <zephyr/kernel.h>
#include <zephyr/net/net_ip.h>
#include <zephyr/shell/shell.h>
#include <zephyr/logging/log.h>
#include <zephyr/sys/byteorder.h>
#include <stdlib.h>
#include <stdio.h>
#include <string.h>
#include <gateway_udp_test.h>

LOG_MODULE_REGISTER(gut_shell, LOG_LEVEL_INF);

#define GUT_SHELL_PAYLOAD_MAX 64

/* ================================================================
 * Shell handlers
 * ================================================================ */
static int cmd_gut_info(const struct shell *ctx, size_t argc, char **argv)
{
	ARG_UNUSED(argc);
	ARG_UNUSED(argv);

	/* 显示 live IP (DHCP 分配或静态配置的当前地址) */
	char ip_str[NET_IPV4_ADDR_LEN] = "-";
	struct in_addr *live = gut_get_live_ipv4();

	if (live) {
		net_addr_ntop(AF_INET, live, ip_str, sizeof(ip_str));
	}
	shell_print(ctx, "ip:        %s (%s)", ip_str, gut_params.use_dhcp ? "DHCP" : "static");
	if (gut_params.use_dhcp) {
		shell_print(ctx, "netmask:   (from DHCP)");
		shell_print(ctx, "gateway:   (from DHCP)");
	} else {
		/* 静态模式: 掩码固定 /24, 网关 = IP 末段改 1 (运行时派生) */
		struct in_addr gw;

		if (net_addr_pton(AF_INET, gut_params.ip_addr, &gw) == 0) {
			((uint8_t *)&gw.s_addr)[3] = 1;
			net_addr_ntop(AF_INET, &gw, ip_str, sizeof(ip_str));
		} else {
			ip_str[0] = '-';
			ip_str[1] = '\0';
		}
		shell_print(ctx, "netmask:   255.255.255.0 (fixed)");
		shell_print(ctx, "gateway:   %s (derived)", ip_str);
	}
	shell_print(ctx, "data port: %d", gut_params.data_port);
	shell_print(ctx, "cfg port:  %d", CONFIG_UDP_FW_CONFIG_PORT);
	shell_print(ctx, "rf24 ch:   %d", gut_params.rf24_channel);
	shell_print(ctx, "rf24 addr: %02x %02x %02x %02x %02x",
		    gut_params.rf24_addr[0], gut_params.rf24_addr[1],
		    gut_params.rf24_addr[2], gut_params.rf24_addr[3],
		    gut_params.rf24_addr[4]);
	shell_print(ctx, "echo:      %s", gut_params.echo ? "on" : "off");
	shell_print(ctx, "log:       %s", gut_params.log ? "on" : "off");
	shell_print(ctx, "running:   %s", gut_params.running ? "yes" : "no");
	return 0;
}

static int cmd_gut_send(const struct shell *ctx, size_t argc, char **argv)
{
	if (argc < 3) {
		shell_error(ctx, "usage: gut send <id_hex> <b0> [b1] ...  (payload hex bytes)");
		return -EINVAL;
	}

	long id = strtol(argv[1], NULL, 16);
	if (id < 0 || id > 0x7FF) {
		shell_error(ctx, "invalid frame id: %s (0-0x7FF)", argv[1]);
		return -EINVAL;
	}

	uint8_t buf[GUT_SHELL_PAYLOAD_MAX];
	size_t off = 2;

	sys_put_be16((uint16_t)id, buf);

	for (int i = 2; i < argc && off < sizeof(buf); i++) {
		long v = strtol(argv[i], NULL, 16);

		if (v < 0 || v > 0xFF) {
			shell_error(ctx, "invalid byte: %s", argv[i]);
			return -EINVAL;
		}
		buf[off++] = (uint8_t)v;
	}

	gut_udp_send(buf, off);
	shell_print(ctx, "TX id=0x%03x len=%zu", (uint16_t)id, off);
	return 0;
}

static int cmd_gut_ping(const struct shell *ctx, size_t argc, char **argv)
{
	int count = 5;

	if (argc >= 2) {
		count = (int)strtol(argv[1], NULL, 10);
		if (count < 1) {
			count = 1;
		} else if (count > 1000) {
			count = 1000;
		}
	}

	/* TEST_FRAME (0x777) 帧格式: [0x07 0x77][seq] */
	uint8_t seq = 0;

	shell_print(ctx, "ping TEST_FRAME(0x777) x%d (echo=%s, loopback via peer)...", count,
		    gut_params.echo ? "on" : "off");

	for (int i = 0; i < count; i++) {
		uint8_t buf[3];

		sys_put_be16(TEST_FRAME, buf);
		buf[2] = seq++;
		gut_udp_send(buf, sizeof(buf));
		shell_print(ctx, "  [%d] TX seq=%02x", i + 1, buf[2]);
		k_msleep(200);
	}

	shell_print(ctx, "done (check if host PC/echo received)");
	return 0;
}

static int cmd_gut_echo(const struct shell *ctx, size_t argc, char **argv)
{
	if (argc < 2) {
		shell_print(ctx, "echo: %s", gut_params.echo ? "on" : "off");
		return 0;
	}
	if (strcmp(argv[1], "on") == 0) {
		gut_params.echo = true;
	} else if (strcmp(argv[1], "off") == 0) {
		gut_params.echo = false;
	} else {
		shell_error(ctx, "usage: gut echo [on|off]");
		return -EINVAL;
	}
	shell_print(ctx, "echo: %s", gut_params.echo ? "on" : "off");
	return 0;
}

static int cmd_gut_log(const struct shell *ctx, size_t argc, char **argv)
{
	if (argc < 2) {
		shell_print(ctx, "log: %s", gut_params.log ? "on" : "off");
		return 0;
	}
	if (strcmp(argv[1], "on") == 0) {
		gut_params.log = true;
	} else if (strcmp(argv[1], "off") == 0) {
		gut_params.log = false;
	} else {
		shell_error(ctx, "usage: gut log [on|off]");
		return -EINVAL;
	}
	shell_print(ctx, "log: %s", gut_params.log ? "on" : "off");
	return 0;
}

static int cmd_gut_ip(const struct shell *ctx, size_t argc, char **argv)
{
	if (argc < 2) {
		/* 显示 live IP (DHCP 模式下是服务器分配的地址) */
		struct in_addr *live = gut_get_live_ipv4();
		char ip_str[NET_IPV4_ADDR_LEN];

		if (live) {
			net_addr_ntop(AF_INET, live, ip_str, sizeof(ip_str));
			shell_print(ctx, "ip: %s (%s)", ip_str,
				    gut_params.use_dhcp ? "DHCP" : "static");
		} else {
			shell_print(ctx, "ip: (no address, stored=%s)", gut_params.ip_addr);
		}
		return 0;
	}
	if (gut_params.use_dhcp) {
		shell_error(ctx, "cannot set static IP in DHCP mode");
		return -EINVAL;
	}
	if (strlen(argv[1]) >= sizeof(gut_params.ip_addr)) {
		shell_error(ctx, "ip too long");
		return -EINVAL;
	}
	strncpy(gut_params.ip_addr, argv[1], sizeof(gut_params.ip_addr) - 1);
	gut_params.ip_addr[sizeof(gut_params.ip_addr) - 1] = '\0';
	persist_save_network_config();
	shell_print(ctx, "ip set to %s (takes effect after reboot)", gut_params.ip_addr);
	return 0;
}

static int cmd_gut_port(const struct shell *ctx, size_t argc, char **argv)
{
	if (argc < 2) {
		shell_print(ctx, "data port: %d", gut_params.data_port);
		return 0;
	}
	long p = strtol(argv[1], NULL, 10);
	if (p < 1 || p > 65535) {
		shell_error(ctx, "invalid port: %s (1-65535)", argv[1]);
		return -EINVAL;
	}
	gut_params.data_port = (uint16_t)p;
	persist_save_network_config();
	shell_print(ctx, "data port set to %d (takes effect after reboot)", gut_params.data_port);
	return 0;
}

SHELL_STATIC_SUBCMD_SET_CREATE(
	sub_gut_cmds,
	SHELL_CMD_ARG(info, NULL, "Show network config", cmd_gut_info, 1, 0),
	SHELL_CMD_ARG(send, NULL,
		      "Send frame <id_hex> <b0> [b1] ... (payload hex bytes)",
		      cmd_gut_send, 3, 16),
	SHELL_CMD_ARG(ping, NULL, "Send TEST_FRAME (0x777) [count=5]", cmd_gut_ping, 1, 1),
	SHELL_CMD_ARG(echo, NULL, "Data port echo [on|off]", cmd_gut_echo, 1, 1),
	SHELL_CMD_ARG(log, NULL, "UDP tx/rx debug log [on|off]", cmd_gut_log, 1, 1),
	SHELL_CMD_ARG(ip, NULL, "Get/set IP <addr>", cmd_gut_ip, 1, 1),
	SHELL_CMD_ARG(port, NULL, "Get/set data port <1-65535>", cmd_gut_port, 1, 1),
	SHELL_SUBCMD_SET_END);

SHELL_CMD_REGISTER(gut, &sub_gut_cmds, "gateway UDP test commands", NULL);

#endif /* CONFIG_SHELL */
```

## src/udp.c
```c
/*
 * Copyright (c) 2026 Kabirz.
 * SPDX-License-Identifier: Apache-2.0
 *
 * UDP 透传模块 (测试版) — 上位机与设备之间的双向 UDP 转发
 * + 网络配置命令处理 (固件升级由 udp_fw_upgrade 库自管)
 *
 * 平移自 gateway/src/udp.c, 去掉 nRF24 无线部分, 数据端口收到的帧
 * 按 gut_params.echo 开关决定是否原样回发 (供 shell 测试).
 *
 * 双端口架构:
 *   - 数据端口 (默认 9090, 可通过 UDP_CMD_SET_CONFIG 配置, 持久化):
 *       上位机数据收发 + (echo 开启时) 原样回显
 *       转发策略: 同子网 → 单播到学习到的源端口; 跨子网/未学习 → 广播到 本地+1
 *   - 配置端口 (固定 9200, 由 udp_fw_upgrade 库自管):
 *       库内部处理固件升级命令 (FW_START/DATA/END),
 *       其余配置命令 (IP/掩码/网关/端口/重启) 通过回调分发到此模块.
 */

#include <string.h>
#include <zephyr/kernel.h>
#include <zephyr/logging/log.h>
#include <zephyr/net/socket.h>
#include <zephyr/net/net_if.h>
#include <zephyr/posix/unistd.h>
#include <zephyr/posix/arpa/inet.h>
#include <zephyr/sys/byteorder.h>
#include <gateway_udp_test.h>
#include <udp_fw_upgrade.h>

LOG_MODULE_REGISTER(gut_udp, LOG_LEVEL_INF);

/* 网络就绪事件位 (由 main 的 net_init 成功后 set). 数据端口线程在 bind 前等待此位,
 * 因为 PHY/MAC 接口注册晚于 K_THREAD_DEFINE 线程启动, 早 bind 会因无接口
 * 返回 EADDRNOTAVAIL. 配置端口由 udp_fw_upgrade 库通过 net_mgmt IF_UP 自管. */
#define NET_READY_BIT 0x1

/* 数据端口 socket + 远端地址 (数据转发目标).
 * data_remote_addr 为最近一次同子网数据发送方地址; 跨子网或未学习时为广播 */
static int data_sock = -1;
static struct sockaddr_in data_remote_addr;

/* ================================================================
 * 子网判断 + 数据端口发送
 * ================================================================ */

/* 取本机 live IPv4 地址 (DHCP 分配或静态配置的当前地址), 失败返回 NULL.
 * DHCP 模式下 gut_params.ip_addr 是旧静态值 (stale), 必须从 live interface 读. */
struct in_addr *gut_get_live_ipv4(void)
{
	struct net_if *iface = net_if_get_default();

	if (!iface) {
		return NULL;
	}
	return (struct in_addr *)net_if_ipv4_get_global_addr(iface, NET_ADDR_PREFERRED);
}

/* 判断发送方 IP 是否与本机同子网 (按 live interface 的实际 IP+掩码计算).
 * 数据端口用此函数决定单播目标, 无法判断时按同子网 (单播) */
static bool is_same_subnet(struct in_addr sender_ip)
{
	struct net_if *iface = net_if_get_default();
	struct in_addr *local_ip;

	if (!iface) {
		return true; /* 无法判断时按同子网处理 (单播) */
	}
	local_ip = gut_get_live_ipv4();
	if (!local_ip) {
		return true;
	}
	struct net_in_addr nm = net_if_ipv4_get_netmask_by_addr(
		iface, (const struct net_in_addr *)local_ip);
	struct in_addr mask = *(struct in_addr *)&nm;

	return (sender_ip.s_addr & mask.s_addr) == (local_ip->s_addr & mask.s_addr);
}

/* 数据端口发送: → 上位机. 同子网单播到 data_remote_addr, 跨子网广播.
 * (与 udp_fw_reply 回复策略一致) */
void gut_udp_send(const uint8_t *data, size_t len)
{
	if (data_sock < 0 || len == 0) {
		return;
	}
	/* 链路 down 时不转发数据到上位机 (网线断开/PHY 未就绪时避免无效 sendto) */
	if (!gut_net_link_up) {
		return;
	}

	struct sockaddr_in dst;

	if (is_same_subnet(data_remote_addr.sin_addr)) {
		dst = data_remote_addr;
	} else {
		dst.sin_family = AF_INET;
		dst.sin_port = htons(gut_params.data_port + 1);
		dst.sin_addr.s_addr = INADDR_BROADCAST;
	}

	sendto(data_sock, data, len, 0, (struct sockaddr *)&dst, sizeof(dst));

	if (gut_params.log && len >= 2) {
		LOG_INF("TX id=0x%03x len=%zu", sys_get_be16(data), len);
	}
}

/* ================================================================
 * 配置命令处理 (应用回调, 由 udp_fw_upgrade 库 RX 线程调用)
 * 处理业务命令: UDP_CMD_SET_CONFIG (0x10) / UDP_CMD_GET_CONFIG (0x11);
 * 固件升级及版本/重启命令 (0x01-0x05) 由库内部处理, 不会到达此处.
 * 回复通过 udp_fw_reply 发送 (库自管 socket + 回复路由).
 * ================================================================ */
static bool app_cmd_handler(uint8_t cmd, const uint8_t *cmd_data, size_t cmd_len,
			    void *user_data)
{
	switch (cmd) {
	case UDP_CMD_SET_NET: {
		/* 设置网络参数: [ip 4B][port 2B BE] = 6B.
		 * 静态模式: 写入 ip_addr + data_port (掩码固定 /24, 网关派生, 不存储).
		 * DHCP 模式: 忽略 ip 字段 (IP 由 DHCP 服务器分配), 只写 data_port.
		 * 回复: 设置后的 6B (IP 取自 live interface 或 ip_addr, 见 GET_NET) */
		if (cmd_len >= 6) {
			struct in_addr addr;

			if (!gut_params.use_dhcp) {
				memcpy(&addr.s_addr, cmd_data, 4);
				inet_ntop(AF_INET, &addr, gut_params.ip_addr, sizeof(gut_params.ip_addr));
			}
			gut_params.data_port = sys_get_be16(cmd_data + 4);

			LOG_INF("UDP set net: ip=%s port=%d dhcp=%d", gut_params.ip_addr,
				gut_params.data_port, gut_params.use_dhcp);
			persist_save_network_config();

			uint8_t resp[6];
			struct in_addr *live = gut_get_live_ipv4();

			if (live) {
				memcpy(resp, &live->s_addr, 4);
			} else if (inet_pton(AF_INET, gut_params.ip_addr, &addr) == 1) {
				memcpy(resp, &addr.s_addr, 4);
			} else {
				memset(resp, 0, 4);
			}
			sys_put_be16(gut_params.data_port, resp + 4);
			udp_fw_reply(cmd, resp, sizeof(resp));
		}
		return true;
	}

	case UDP_CMD_GET_NET: {
		/* 查询网络参数: (空) → [ip 4B][port 2B BE] = 6B.
		 * IP 取自 live interface (DHCP 模式下是实际拿到的地址; 静态模式下与
		 * gut_params.ip_addr 一致). 拿不到 live IP 时回退 gut_params.ip_addr. */
		uint8_t buf[6];
		struct in_addr addr;
		struct in_addr *live = gut_get_live_ipv4();

		if (live) {
			memcpy(buf, &live->s_addr, 4);
		} else if (inet_pton(AF_INET, gut_params.ip_addr, &addr) == 1) {
			memcpy(buf, &addr.s_addr, 4);
		} else {
			memset(buf, 0, 4);
		}
		sys_put_be16(gut_params.data_port, buf + 4);
		udp_fw_reply(cmd, buf, sizeof(buf));
		return true;
	}

	case UDP_CMD_SET_RF24: {
		/* 设置 RF24 参数: [ch 1B][addr 5B] = 6B (无硬件, 仅持久化).
		 * ch 非法 (>125) 时保持原值不更新, 但不拒绝整包.
		 * 回复: 设置后的 6B (回显) */
		if (cmd_len >= 6) {
			uint8_t ch = cmd_data[0];

			if (ch <= RF24_ADDR_MAX_CH) {
				gut_params.rf24_channel = ch;
			}
			memcpy(gut_params.rf24_addr, cmd_data + 1, RF24_ADDR_LEN);

			LOG_INF("UDP set rf24: ch=%d addr=%02x%02x%02x%02x%02x",
				gut_params.rf24_channel, gut_params.rf24_addr[0],
				gut_params.rf24_addr[1], gut_params.rf24_addr[2],
				gut_params.rf24_addr[3], gut_params.rf24_addr[4]);
			persist_save_rf24_config();

			uint8_t resp[6];

			resp[0] = gut_params.rf24_channel;
			memcpy(resp + 1, gut_params.rf24_addr, RF24_ADDR_LEN);
			udp_fw_reply(cmd, resp, sizeof(resp));
		}
		return true;
	}

	case UDP_CMD_GET_RF24: {
		/* 查询 RF24 参数: (空) → [ch 1B][addr 5B] = 6B */
		uint8_t buf[6];

		buf[0] = gut_params.rf24_channel;
		memcpy(buf + 1, gut_params.rf24_addr, RF24_ADDR_LEN);
		udp_fw_reply(cmd, buf, sizeof(buf));
		return true;
	}

	case UDP_CMD_SET_NET_MODE: {
		/* 设置网络模式: [mode 1B] (0=静态,1=DHCP). 持久化, 重启生效.
		 * 回复: 设置后的 1B (回显) */
		if (cmd_len >= 1) {
			uint8_t mode = cmd_data[0];

			if (mode <= 1) {
				gut_params.use_dhcp = mode;
				LOG_INF("UDP set net mode: %s", mode ? "DHCP" : "static");
				persist_save_network_config();
			}
			uint8_t resp = gut_params.use_dhcp;
			udp_fw_reply(cmd, &resp, sizeof(resp));
		}
		return true;
	}

	case UDP_CMD_GET_NET_MODE: {
		/* 查询网络模式: (空) → [mode 1B] (0=静态,1=DHCP) */
		uint8_t mode = gut_params.use_dhcp;
		udp_fw_reply(cmd, &mode, sizeof(mode));
		return true;
	}

	default:
		return false;
	}
}

/* ================================================================
 * 数据端口接收线程 (绑定 gut_params.data_port, 默认 9090)
 * 收到上位机数据帧 → 按 echo 开关原样回发 (供测试); 同时学习 data_remote_addr
 * ================================================================ */
static void udp_data_rx_thread(void)
{
	/* 等待网络接口就绪 (main 中 net_init 成功) 再创建 socket, 否则 bind
	 * 会因无可用接口返回 EADDRNOTAVAIL. */
	k_event_wait(&gut_params.event, NET_READY_BIT, false, K_FOREVER);

	data_sock = socket(AF_INET, SOCK_DGRAM, IPPROTO_UDP);
	if (data_sock < 0) {
		LOG_ERR("data socket create failed: %d", errno);
		return;
	}

	struct sockaddr_in local_addr = {
		.sin_family = AF_INET,
		.sin_port = htons(gut_params.data_port),
	};

	if (bind(data_sock, (struct sockaddr *)&local_addr, sizeof(local_addr)) < 0) {
		LOG_ERR("data socket bind failed: %d", errno);
		close(data_sock);
		data_sock = -1;
		return;
	}

	LOG_INF("data port %d listening", gut_params.data_port);

	/* 默认广播目标: 未学习到同子网发送方前, 数据以广播发出 */
	data_remote_addr.sin_family = AF_INET;
	data_remote_addr.sin_port = htons(gut_params.data_port);
	data_remote_addr.sin_addr.s_addr = INADDR_BROADCAST;

	uint8_t buf[512];

	while (1) {
		struct sockaddr_in src_addr;
		socklen_t addr_len = sizeof(src_addr);

		ssize_t received = recvfrom(data_sock, buf, sizeof(buf), 0,
					    (struct sockaddr *)&src_addr, &addr_len);
		if (received <= 0) {
			continue;
		}

		if (is_same_subnet(src_addr.sin_addr)) {
			data_remote_addr = src_addr;
		}

		if (received >= 2) {
			uint16_t can_id = sys_get_be16(buf);

			if (gut_params.log) {
				LOG_INF("RX id=0x%03x len=%zd", can_id, received);
			}

			/* echo 模式: 原样回发收到的帧 (含帧 ID) */
			if (gut_params.echo) {
				gut_udp_send(buf, received);
			}
		}
	}
}

K_THREAD_DEFINE(thread_udp_data_rx, CONFIG_GUT_DATA_RX_STACK, udp_data_rx_thread, NULL, NULL,
		NULL, CONFIG_GUT_DATA_RX_PRIORITY, 0, 0);

/* ================================================================
 * 初始化: 注册配置命令回调 (固件升级库通过 net_mgmt IF_UP 自管配置端口 socket)
 * ================================================================ */
static int gut_udp_init(void)
{
	udp_fw_set_app_handler(app_cmd_handler, NULL);
	return 0;
}

SYS_INIT(gut_udp_init, APPLICATION, CONFIG_GUT_UDP_INIT_PRIORITY);
```
