## CMakeLists.txt
```
# SPDX-License-Identifier: Apache-2.0

cmake_minimum_required(VERSION 3.20.0)

find_package(Zephyr REQUIRED HINTS $ENV{ZEPHYR_BASE})
project(spi_master_slave)

target_sources(app PRIVATE
  src/main.c
  src/master.c
  src/slave.c
)
```

## prj.conf
```kconfig
# nothing here
CONFIG_SPI=y
CONFIG_SPI_SLAVE=y
CONFIG_GPIO=y
CONFIG_SHELL=y
CONFIG_GPIO_SHELL=y
CONFIG_LOG=y
CONFIG_USE_SEGGER_RTT=n
CONFIG_SHELL_BACKEND_RTT=n
```

## src/main.c
```c
#include <stdio.h>
#include <zephyr/kernel.h>

extern void slave_proccess(void);

int main(void)
{
	printf("Hello World! %s\n", CONFIG_BOARD_TARGET);
	while (true) {
		slave_proccess();
	}

	return 0;
}
```

## src/master.c
```c
#include <zephyr/kernel.h>
#include <zephyr/drivers/spi.h>
#include <zephyr/shell/shell.h>

static const struct device *spi_dev = DEVICE_DT_GET(DT_NODELABEL(spi1));

static uint8_t tx_buffer[128];
static uint8_t rx_buffer[128];

static int cmd_mspi_write(const struct shell *ctx, size_t argc, char **argv)
{
	const struct spi_config config = {
		.frequency = MHZ(1),
		.cs = {
			.gpio = GPIO_DT_SPEC_GET(DT_NODELABEL(spi1), cs_gpios),
		},
	};

	const struct spi_buf tx_buffers = {.buf = tx_buffer, .len = sizeof(tx_buffer)};
	const struct spi_buf rx_buffers = {.buf = rx_buffer, .len = sizeof(rx_buffer)};

	const struct spi_buf_set tx_buf_set = {.buffers = &tx_buffers, .count = 1};
	const struct spi_buf_set rx_buf_set = {.buffers = &rx_buffers, .count = 1};

	memcpy(tx_buffer, argv[1], strlen(argv[1])+1);

	if (spi_transceive(spi_dev, &config, &tx_buf_set, &rx_buf_set)) {
		shell_error(ctx, "spi transfer error");
		return -1;
	} else {
		shell_hexdump(ctx, rx_buffer, sizeof(rx_buffer));
	}

	return 0;
}

SHELL_STATIC_SUBCMD_SET_CREATE(sub_mspi_cmds,
			       SHELL_CMD_ARG(write, NULL,
					     "master spi write\n"
					     "Usage: write <str>",
					     cmd_mspi_write, 2, 0),
			       SHELL_SUBCMD_SET_END);

SHELL_CMD_REGISTER(mspi, &sub_mspi_cmds, "Spi Flash commands", NULL);
```

## src/slave.c
```c
#include "zephyr/init.h"
#include <zephyr/kernel.h>
#include <zephyr/drivers/spi.h>
#include <zephyr/drivers/gpio.h>
#include <zephyr/logging/log.h>
LOG_MODULE_REGISTER(slave_callback);

static const struct device *spi_dev = DEVICE_DT_GET(DT_NODELABEL(spi2));
static const struct device *cs_dev = DEVICE_DT_GET(DT_NODELABEL(gpioa)); // PA4
#define INT_PIN 4

const struct spi_config config = {
	.operation = SPI_OP_MODE_SLAVE,
};

static struct gpio_callback int_gpio_cb;

static uint8_t rx_buffer[128];
const struct spi_buf rx_buffers = {.buf = rx_buffer, .len = sizeof(rx_buffer)};
const struct spi_buf_set rx_buf_set = {.buffers = &rx_buffers, .count = 1};
static K_SEM_DEFINE(slave_sem, 1, 1);

void slave_proccess(void)
{
	k_sem_take(&slave_sem, K_FOREVER);
	k_busy_wait(10);
	if (gpio_pin_get(cs_dev, INT_PIN) != 0) return;

	int ret = spi_read(spi_dev, &config, &rx_buf_set);
	if (ret < 0) {
		LOG_ERR("slave spi read error!");
		return;
	}
	LOG_HEXDUMP_INF(rx_buffer, ret, "RX:");
}

static void cs_isr_handler(const struct device *dev, struct gpio_callback *cb, uint32_t pins)
{
	k_sem_give(&slave_sem);
}

static int slave_init(void)
{
	int r;
	r = gpio_pin_configure(cs_dev, INT_PIN, GPIO_INPUT);
	if (r < 0) {
		LOG_ERR("Could not configure interrupt GPIO pin");
		return r;
	}

	r = gpio_pin_interrupt_configure(cs_dev, INT_PIN, GPIO_INT_EDGE_TO_INACTIVE);
	if (r < 0) {
		LOG_ERR("Could not configure interrupt GPIO interrupt.");
		return r;
	}

	gpio_init_callback(&int_gpio_cb, cs_isr_handler, BIT(INT_PIN));

	r = gpio_add_callback(cs_dev, &int_gpio_cb);
	if (r < 0) {
		LOG_ERR("Could not set gpio callback");
		return r;
	}

	return 0;
}

SYS_INIT(slave_init, APPLICATION, 10);
```
