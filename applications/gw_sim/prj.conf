## CMakeLists.txt
```
# SPDX-License-Identifier: Apache-2.0

cmake_minimum_required(VERSION 3.20.0)

find_package(Zephyr REQUIRED HINTS $ENV{ZEPHYR_BASE})
project(gw_sim)

target_include_directories(app PRIVATE include)
target_sources(app PRIVATE
  src/main.c
  src/rf24_stub.c
  src/udp.c
)
```

## Kconfig
```
# SPDX-License-Identifier: Apache-2.0
# gw_sim application configuration

mainmenu "gw_sim"

source "Kconfig.zephyr"

config GATEWAY_DATA_RX_STACK
	int "UDP data RX thread stack size"
	default 1024

config GATEWAY_DATA_RX_PRIORITY
	int "UDP data RX thread priority"
	default 10

config GATEWAY_UDP_STACK
	int "UDP config RX thread stack size"
	default 1024

config GATEWAY_UDP_PRIORITY
	int "UDP config RX thread priority"
	default 10
```

## prj.conf
```kconfig
CONFIG_MAIN_STACK_SIZE=2048
CONFIG_LOG=y

# native_sim 网络: nsos socket offload.
# native_sim 用 NATIVE_LIBC(主机 glibc), socket() 会落到主机 glibc 绕过 Zephyr 网络栈;
# nsos offload 让 socket() 走 Zephyr offload dispatcher→主机网络 (echo_server native_sim 同方案).
CONFIG_ETH_NATIVE_TAP=n
CONFIG_NET_DRIVERS=y
CONFIG_NET_SOCKETS_OFFLOAD=y
CONFIG_NET_NATIVE_OFFLOADED_SOCKETS=y

# 网络栈
CONFIG_NETWORKING=y
CONFIG_NET_IPV4=y
CONFIG_NET_UDP=y
CONFIG_NET_SOCKETS=y
CONFIG_POSIX_API=y
CONFIG_POSIX_NETWORKING=y  # 启用 Zephyr socket() (否则 native_sim 链接主机 glibc socket)
CONFIG_NET_ARP=y

# 链路事件等待 (NET_EVENT_IF_UP, 与 gateway 一致)
CONFIG_NET_MGMT=y
CONFIG_NET_MGMT_EVENT=y

# RNG (native_sim 无硬件 RNG)
CONFIG_TEST_RANDOM_GENERATOR=y

# sys_reboot (REBOOT 命令 + 固件升级 FW_END 重启)
CONFIG_REBOOT=y

# 调试: 定位 socket errno 93 (临时, 定位后移除)
CONFIG_NET_LOG=y
CONFIG_NET_CONTEXT_LOG_LEVEL_DBG=y
CONFIG_NET_SOCKETS_LOG_LEVEL_DBG=y
```

## src/main.c
```c
/*
 * Copyright (c) 2026 Kabirz.
 * SPDX-License-Identifier: Apache-2.0
 *
 * gw_sim 主入口 - gateway 网络代码的 native_sim 移植版
 * nsos 模式: socket 走主机网络 (NET_SOCKETS_OFFLOAD), 无需 net_if_up/链路等待.
 * UDP 双端口/配置命令/固件升级 由 udp.c 的接收线程处理 (nsos socket).
 */

#include <stdio.h>
#include <string.h>
#include <zephyr/kernel.h>
#include <gateway.h>
#include <zephyr/app_version.h>

#include <zephyr/logging/log.h>
LOG_MODULE_REGISTER(gw_sim, LOG_LEVEL_INF);

gateway_params_t gw_params;

int main(void)
{
	/* native_sim stdout 默认全缓冲, 重定向到文件时日志不即时 flush. 改行缓冲. */
	setvbuf(stdout, NULL, _IOLBF, 0);

	LOG_INF("build time: %s-%s", __DATE__, __TIME__);
	LOG_INF("board: %s, version: %s", CONFIG_BOARD_TARGET, APP_VERSION_STRING);

	/* 初始化默认配置 (无持久化) */
	gw_params.rf24_channel = RF24_DEFAULT_CH;
	memset(gw_params.rf24_addr, 0, RF24_ADDR_LEN);
	strncpy(gw_params.ip_addr, GATEWAY_DEFAULT_IP, sizeof(gw_params.ip_addr) - 1);
	strncpy(gw_params.netmask, GATEWAY_DEFAULT_MASK, sizeof(gw_params.netmask) - 1);
	strncpy(gw_params.gateway, GATEWAY_DEFAULT_GW, sizeof(gw_params.gateway) - 1);
	gw_params.data_port = GATEWAY_DATA_PORT_DEFAULT;

	/* 初始化各模块 (nRF24 stub) */
	gw_rf24_init();

	/* nsos 模式: socket 由 udp.c 接收线程经主机网络创建, 主线程无需 net_if 操作 */
	LOG_INF("Network config: %s/%s gw %s (nsos host networking)",
		gw_params.ip_addr, gw_params.netmask, gw_params.gateway);
	gw_params.running = true;
	LOG_INF("gw_sim ready");

	while (1) {
		k_sleep(K_MSEC(1000));
	}

	return 0;
}
```

## include/gateway.h
```c
/*
 * Copyright (c) 2026 Kabirz.
 * SPDX-License-Identifier: Apache-2.0
 *
 * gw_sim application common definitions
 * (移植自 gateway, 裁剪 persist/settings/rf24_shell 相关声明)
 */

#ifndef __GATEWAY_H__
#define __GATEWAY_H__

#include <zephyr/kernel.h>
#include <stdbool.h>
#include <stdint.h>

/* ================================================================
 * RF24 地址/信道配置
 * ================================================================ */
#define RF24_ADDR_LEN    5
#define RF24_ADDR_MAX_CH 125
#define RF24_DEFAULT_CH  76

/* ================================================================
 * 帧 ID (与 gateway/mod_handler 保持一致; nRF24/UDP 帧协议的逻辑标识符,
 * 复用历史 CAN 11-bit 编号, 已与 CAN 总线无关)
 * ================================================================ */
enum can_ids {
	RF24_CONFIG_CMD = 0x104,
	RF24_CONFIG_RESP = 0x105,
	NET_CONFIG_CMD = 0x106,   /* 平台→网关: 网络配置命令 */
	NET_CONFIG_RESP = 0x107,  /* 网关→平台: 网络配置响应 */
	COBID_HEATBEAT = 0x763,
	TEST_FRAME = 0x777,
	HANDLER_STATE = 0x1E3,
	OVERBREAK_LASER = 0x263,
	COORD_XY = 0x363,
	COORD_Z = 0x463,
};

/* RF24_CONFIG_CMD 命令类型 */
enum rf24_config_cmd {
	RF24_CMD_SET_CHANNEL = 0x01,
	RF24_CMD_GET_CONFIG = 0x02,
	RF24_CMD_SET_ADDR = 0x03,    /* 设置地址: [0x03][addr 5B][reserved 2B] */
};

/* NET_CONFIG_CMD 命令类型 */
enum net_config_cmd {
	NET_CMD_SET_IP = 0x01,       /* [0x01][ip 4B] */
	NET_CMD_SET_MASK = 0x02,     /* [0x02][mask 4B] */
	NET_CMD_SET_GW = 0x03,       /* [0x03][gw 4B] */
	NET_CMD_SET_PORT = 0x04,     /* [0x04][port 2B BE] */
	NET_CMD_GET_CONFIG = 0x05,   /* [0x05] 查询全部配置 */
};

/* ================================================================
 * 网络默认配置
 * ================================================================ */
#define GATEWAY_DEFAULT_IP       "192.168.1.100"
#define GATEWAY_DEFAULT_MASK     "255.255.255.0"
#define GATEWAY_DEFAULT_GW       "192.168.1.1"
#define GATEWAY_DATA_PORT_DEFAULT 9090  /* 数据端口 (可配, UDP_CMD_SET_PORT) */
#define GATEWAY_CONFIG_PORT      9200  /* 配置端口 (固定, 不受 SET_PORT 影响) */

/* ================================================================
 * 全局状态
 * ================================================================ */
typedef struct {
	/* RF24 配置 */
	uint8_t rf24_channel;
	uint8_t rf24_addr[RF24_ADDR_LEN];

	/* 网络配置 */
	char ip_addr[16];
	char netmask[16];
	char gateway[16];
	uint16_t data_port;   /* 数据端口 (可配, 默认 GATEWAY_DATA_PORT_DEFAULT) */

	/* 运行状态 */
	volatile bool running;
} gateway_params_t;

extern gateway_params_t gw_params;

/* ================================================================
 * 接口声明
 * ================================================================ */

/* rf24_stub.c (native_sim 无射频, stub 实现) */
void gw_rf24_init(void);
void gw_rf24_set_config(uint8_t channel, const uint8_t *addr);
bool gw_rf24_send(uint16_t can_id, const uint8_t *data, size_t len);

/* udp.c */
void gw_udp_send(const uint8_t *data, size_t len);

#endif /* __GATEWAY_H__ */
```

## src/rf24_stub.c
```c
/*
 * Copyright (c) 2026 Kabirz.
 * SPDX-License-Identifier: Apache-2.0
 *
 * nRF24 stub - native_sim 无射频硬件, 接口空实现 + 日志.
 * udp.c 的数据转发 (gw_rf24_send) 与配置命令 (gw_rf24_set_config) 调用此 stub,
 * 保留调用点以验证 UDP→nRF24 转发路径与配置命令流程.
 */

#include <zephyr/kernel.h>
#include <zephyr/logging/log.h>
#include <gateway.h>

LOG_MODULE_REGISTER(gw_rf24, LOG_LEVEL_INF);

void gw_rf24_init(void)
{
	LOG_INF("rf24 stub init (native_sim, no radio)");
}

void gw_rf24_set_config(uint8_t channel, const uint8_t *addr)
{
	LOG_INF("rf24 stub set_config: ch=%u (addr not applied)", channel);
}

bool gw_rf24_send(uint16_t can_id, const uint8_t *data, size_t len)
{
	LOG_INF("rf24 stub send: id=0x%03x len=%u (not transmitted)", can_id, (unsigned)len);
	LOG_HEXDUMP_DBG(data, len, "rf24 stub payload");
	return true;
}
```

## src/udp.c
```c
/*
 * Copyright (c) 2026 Kabirz.
 * SPDX-License-Identifier: Apache-2.0
 *
 * UDP 透传模块 - nRF24 与上位机之间的双向 UDP 转发
 * + 网络配置 + 固件升级 (通过 UDP)
 * (移植自 gateway: flash 写入层 stub, 去 settings 持久化)
 *
 * 双端口架构 (数据/配置端口均支持广播收发, 均按子网判断单播/广播):
 *   - 数据端口 (默认 9090, 可通过 UDP_CMD_SET_PORT 配置):
 *       nRF24 → 上位机数据转发 (gw_udp_send) + 上位机 → nRF24 扫描仪数据透传
 *       转发策略: 目标与本机同子网 → 单播; 跨子网/未学习 → 广播
 *   - 配置端口 (固定 9200, 不可改):
 *       所有配置命令 (IP/掩码/网关/端口/RF24/重启/固件升级)
 *       支持广播接收 (上位机不知道设备 IP 时可广播配置)
 *       回复策略: 发送方与本机同子网 → 单播; 跨子网 → 广播
 *
 * 配置命令帧格式: [cmd 1B][data...] (无魔数头, 配置端口只收命令)
 * 数据帧格式: [帧 ID 2B BE][payload]  (帧 ID 见 enum can_ids, 复用历史编号)
 *
 * gw_sim 差异: 配置只存内存 (无 persist); 固件升级 flash 写入改 stub (计数+日志).
 */

#include <string.h>
#include <zephyr/kernel.h>
#include <zephyr/logging/log.h>
#include <zephyr/app_version.h>
/* native_sim NATIVE_LIBC: socket() 走主机 glibc, 须用 glibc 的 socket 头与类型
 * (Zephyr net_ip.h 的 sockaddr_in 为 8B, 与 glibc 16B 不一致 → bind EINVAL;
 *  net_compat.h AF_INET=1 与 Linux AF_INET=2 冲突). 直接 include 主机 glibc 头. */
#include <sys/socket.h>
#include <netinet/in.h>
#include <arpa/inet.h>
#include <unistd.h>
#include <zephyr/sys/byteorder.h>
#include <zephyr/sys/reboot.h>
#include <gateway.h>

LOG_MODULE_REGISTER(gw_udp, LOG_LEVEL_INF);


enum udp_cmd {
	UDP_CMD_SET_IP = 0x01,
	UDP_CMD_SET_MASK = 0x02,
	UDP_CMD_SET_GW = 0x03,
	UDP_CMD_SET_PORT = 0x04,
	UDP_CMD_GET_CONFIG = 0x05,
	UDP_CMD_GET_VERSION = 0x06,
	UDP_CMD_SET_RF24_CH = 0x07,
	UDP_CMD_SET_RF24_ADDR = 0x08,
	UDP_CMD_REBOOT = 0x09,
	UDP_CMD_FW_START = 0x10,
	UDP_CMD_FW_DATA = 0x11,
	UDP_CMD_FW_END = 0x12,
};

/* 数据端口 socket + 远端地址 (nRF24 数据转发目标).
 * data_remote_addr 为最近一次同子网数据发送方地址; 跨子网或未学习时为广播 */
static int data_sock = -1;
static struct sockaddr_in data_remote_addr;

/* 配置端口 socket + 远端地址 (配置命令回复目标).
 * config_remote_addr 为最近一次配置命令发送方地址 */
static int config_sock = -1;
static struct sockaddr_in config_remote_addr;

/* ================================================================
 * 固件升级状态 (stub: 无 flash 写入, 仅计数验证协议分包)
 * ================================================================ */
static bool fw_started = false;
static size_t fw_total_bytes;

static void fw_reset(void)
{
	if (fw_started) {
		fw_started = false;
		LOG_INF("FW upgrade complete");
	}
}

/* ================================================================
 * 子网判断 + UDP 发送
 * ================================================================ */

/* 判断发送方 IP 是否与本机同子网 (按 netmask 计算).
 * 数据/配置端口均用此函数决定单播目标, 无法判断时按同子网 (单播) */
static bool is_same_subnet(struct in_addr sender_ip)
{
	/* nsos 主机网络模式: 发送方都在主机网络, 直接单播回复 (避免 gw_params 静态 IP
	 * 与主机实际 IP 不一致导致误判广播). */
	ARG_UNUSED(sender_ip);
	return true;
}

/* 数据端口发送: nRF24 数据 → 上位机. 同子网单播到 data_remote_addr, 跨子网广播.
 * (与 config_send_resp 回复策略一致) */
void gw_udp_send(const uint8_t *data, size_t len)
{
	if (data_sock < 0 || len == 0) {
		return;
	}

	struct sockaddr_in dst;

	if (is_same_subnet(data_remote_addr.sin_addr)) {
		dst = data_remote_addr;
	} else {
		dst.sin_family = AF_INET;
		dst.sin_port = htons(gw_params.data_port);
		dst.sin_addr.s_addr = INADDR_BROADCAST;
	}

	sendto(data_sock, data, len, 0, (struct sockaddr *)&dst, sizeof(dst));
}

/* 配置端口回复: 通过配置 socket 回复. 同子网单播给发送方, 跨子网广播.
 * 回复格式: [cmd 1B][data...] (无魔数头) */
static void config_send_resp(uint8_t cmd, const uint8_t *data, uint8_t len)
{
	if (config_sock < 0) {
		return;
	}

	uint8_t buf[64] = {0};
	size_t send_len = 1; /* cmd */

	buf[0] = cmd;
	if (len > 0 && len <= sizeof(buf) - 1) {
		memcpy(buf + 1, data, len);
		send_len += len;
	}

	/* 同子网单播回复; 跨子网广播回复 (让跨网段的上位机也能收到) */
	struct sockaddr_in dst;

	if (is_same_subnet(config_remote_addr.sin_addr)) {
		dst = config_remote_addr;
	} else {
		dst.sin_family = AF_INET;
		dst.sin_port = htons(GATEWAY_CONFIG_PORT);
		dst.sin_addr.s_addr = INADDR_BROADCAST;
	}

	sendto(config_sock, buf, send_len, 0, (struct sockaddr *)&dst, sizeof(dst));
}

/* ================================================================
 * UDP 命令处理
 * ================================================================ */
static void udp_cmd_handler(const uint8_t *data, size_t len)
{
	if (len < 1) {
		return;
	}

	uint8_t cmd = data[0];
	const uint8_t *cmd_data = data + 1;
	size_t cmd_len = len - 1;

	switch (cmd) {
	case UDP_CMD_SET_IP:
		if (cmd_len >= 4) {
			struct in_addr addr;

			memcpy(&addr.s_addr, cmd_data, 4);
			inet_ntop(AF_INET, &addr, gw_params.ip_addr, sizeof(gw_params.ip_addr));
			LOG_INF("UDP set IP: %s", gw_params.ip_addr);
			config_send_resp(cmd, (uint8_t *)gw_params.ip_addr, strlen(gw_params.ip_addr));
		}
		break;

	case UDP_CMD_SET_MASK:
		if (cmd_len >= 4) {
			struct in_addr mask;

			memcpy(&mask.s_addr, cmd_data, 4);
			inet_ntop(AF_INET, &mask, gw_params.netmask, sizeof(gw_params.netmask));
			LOG_INF("UDP set mask: %s", gw_params.netmask);
			config_send_resp(cmd, (uint8_t *)gw_params.netmask, strlen(gw_params.netmask));
		}
		break;

	case UDP_CMD_SET_GW:
		if (cmd_len >= 4) {
			struct in_addr gw;

			memcpy(&gw.s_addr, cmd_data, 4);
			inet_ntop(AF_INET, &gw, gw_params.gateway, sizeof(gw_params.gateway));
			LOG_INF("UDP set gw: %s", gw_params.gateway);
			config_send_resp(cmd, (uint8_t *)gw_params.gateway, strlen(gw_params.gateway));
		}
		break;

	case UDP_CMD_SET_PORT:
		if (cmd_len >= 2) {
			gw_params.data_port = sys_get_be16(cmd_data);
			LOG_INF("UDP set data port: %d", gw_params.data_port);
			config_send_resp(cmd, cmd_data, 2);
		}
		break;

	case UDP_CMD_GET_CONFIG: {
		uint8_t buf[32] = {0};
		int offset = 0;

		buf[offset++] = gw_params.rf24_channel;
		memcpy(buf + offset, gw_params.rf24_addr, RF24_ADDR_LEN);
		offset += RF24_ADDR_LEN;
		sys_put_be16(gw_params.data_port, buf + offset);
		offset += 2;
		sys_put_be16(GATEWAY_CONFIG_PORT, buf + offset);
		offset += 2;
		config_send_resp(cmd, buf, offset);
		break;
	}

	case UDP_CMD_GET_VERSION:
		/* 响应 APP_VERSION_STRING (含 EXTRAVERSION, 如 "0.1.0-dev").
		 * 变长字符串, 不含末尾 '\0' */
		config_send_resp(cmd, (const uint8_t *)APP_VERSION_STRING,
				 strlen(APP_VERSION_STRING));
		break;

	case UDP_CMD_SET_RF24_CH:
		if (cmd_len >= 1 && cmd_data[0] <= RF24_ADDR_MAX_CH) {
			gw_params.rf24_channel = cmd_data[0];
			gw_rf24_set_config(gw_params.rf24_channel, gw_params.rf24_addr);
			LOG_INF("UDP set rf24 ch: %d", gw_params.rf24_channel);
		}
		config_send_resp(cmd, &gw_params.rf24_channel, 1);
		break;

	case UDP_CMD_SET_RF24_ADDR:
		if (cmd_len >= RF24_ADDR_LEN) {
			memcpy(gw_params.rf24_addr, cmd_data, RF24_ADDR_LEN);
			gw_rf24_set_config(gw_params.rf24_channel, gw_params.rf24_addr);
			LOG_INF("UDP set rf24 addr");
		}
		config_send_resp(cmd, gw_params.rf24_addr, RF24_ADDR_LEN);
		break;

	case UDP_CMD_REBOOT:
		LOG_INF("UDP reboot requested");
		config_send_resp(cmd, NULL, 0);
		k_msleep(100);
		sys_reboot(SYS_REBOOT_COLD);
		break;

	case UDP_CMD_FW_START:
		if (!fw_started) {
			fw_started = true;
			fw_total_bytes = 0;
			LOG_INF("FW upgrade started (stub, no flash write)");
		}
		config_send_resp(cmd, (uint8_t *)"ok", 2);
		break;

	case UDP_CMD_FW_DATA:
		if (fw_started && cmd_len > 0) {
			fw_total_bytes += cmd_len;
			LOG_DBG("FW chunk: +%zu (total %zu)", cmd_len, fw_total_bytes);
			config_send_resp(cmd, (uint8_t *)"ok", 2);
		}
		break;

	case UDP_CMD_FW_END:
		if (fw_started) {
			LOG_INF("FW upgrade end (stub), total %zu bytes", fw_total_bytes);
			fw_reset();
			config_send_resp(cmd, (uint8_t *)"ok", 2);
			k_msleep(500);
			sys_reboot(SYS_REBOOT_COLD);
		}
		break;

	default:
		LOG_DBG("Unknown UDP cmd: 0x%02x", cmd);
		break;
	}
}

/* ================================================================
 * 数据端口接收线程 (绑定 gw_params.data_port, 默认 9090)
 * 收到上位机扫描仪数据帧 → 透传到 nRF24; 同时学习 data_remote_addr
 * (nRF24 数据转发目标, 见 gw_udp_send)
 * ================================================================ */
static void udp_data_rx_thread(void)
{
	data_sock = socket(AF_INET, SOCK_DGRAM, IPPROTO_UDP);
	LOG_INF("data socket(AF=%d TYPE=%d PROTO=%d) => fd=%d errno=%d",
		AF_INET, SOCK_DGRAM, IPPROTO_UDP, data_sock, errno);
	if (data_sock < 0) {
		LOG_ERR("data socket create failed: %d", errno);
		return;
	}

	struct sockaddr_in local_addr = {
		.sin_family = AF_INET,
		.sin_port = htons(gw_params.data_port),
	};

	if (bind(data_sock, (struct sockaddr *)&local_addr, sizeof(local_addr)) < 0) {
		LOG_ERR("data socket bind failed: %d", errno);
		close(data_sock);
		data_sock = -1;
		return;
	}

	LOG_INF("data port %d listening", gw_params.data_port);

	/* 默认广播目标: 未学习到同子网发送方前, nRF24 数据以广播发出 */
	data_remote_addr.sin_family = AF_INET;
	data_remote_addr.sin_port = htons(gw_params.data_port);
	data_remote_addr.sin_addr.s_addr = INADDR_BROADCAST;

	uint8_t buf[512];

	while (1) {
		struct sockaddr_in src_addr;
		socklen_t addr_len = sizeof(src_addr);

		ssize_t received = recvfrom(data_sock, buf, sizeof(buf), 0,
					    (struct sockaddr *)&src_addr, &addr_len);
		if (received <= 0) {
			continue;
		}

		/* 仅学习同子网发送方地址 (供 nRF24→UDP 转发的单播目标);
		 * 跨子网的包不更新目标, gw_udp_send 仍按广播发出,
		 * 避免跨网段噪声劫持数据流 */
		if (is_same_subnet(src_addr.sin_addr)) {
			data_remote_addr = src_addr;
		}

		/* 数据端口处理扫描仪数据帧透传到 nRF24 */
		if (received >= 2) {
			uint16_t can_id = sys_get_be16(buf);

			if (can_id == OVERBREAK_LASER || can_id == COORD_XY ||
			    can_id == COORD_Z) {
				gw_rf24_send(can_id, buf + 2, received - 2);
				LOG_DBG("UDP->nRF24: id=0x%03x len=%zd", can_id,
					received - 2);
			}
		}
	}
}

K_THREAD_DEFINE(thread_udp_data_rx, CONFIG_GATEWAY_DATA_RX_STACK, udp_data_rx_thread, NULL, NULL,
		NULL, CONFIG_GATEWAY_DATA_RX_PRIORITY, 0, 0);

/* ================================================================
 * 配置端口接收线程 (绑定 0.0.0.0:9200, INADDR_ANY 以收广播配置命令)
 * 收到配置命令 → udp_cmd_handler; 学习 config_remote_addr (供回复)
 * ================================================================ */
static void udp_config_rx_thread(void)
{
	config_sock = socket(AF_INET, SOCK_DGRAM, IPPROTO_UDP);
	LOG_INF("config socket(AF=%d TYPE=%d PROTO=%d) => fd=%d errno=%d",
		AF_INET, SOCK_DGRAM, IPPROTO_UDP, config_sock, errno);
	if (config_sock < 0) {
		LOG_ERR("config socket create failed: %d", errno);
		return;
	}

	struct sockaddr_in local_addr = {
		.sin_family = AF_INET,
		.sin_port = htons(GATEWAY_CONFIG_PORT),
	};

	if (bind(config_sock, (struct sockaddr *)&local_addr, sizeof(local_addr)) < 0) {
		LOG_ERR("config socket bind failed: %d", errno);
		close(config_sock);
		config_sock = -1;
		return;
	}

	LOG_INF("config port %d listening", GATEWAY_CONFIG_PORT);

	uint8_t buf[512];

	while (1) {
		struct sockaddr_in src_addr;
		socklen_t addr_len = sizeof(src_addr);

		ssize_t received = recvfrom(config_sock, buf, sizeof(buf), 0,
					    (struct sockaddr *)&src_addr, &addr_len);
		if (received <= 0) {
			continue;
		}

		/* 记录配置端口发送方地址 (config_send_resp 按子网判断单播/广播回复) */
		config_remote_addr = src_addr;

		/* 配置端口只收命令帧, 直接交给 handler ([cmd 1B][data...]) */
		udp_cmd_handler(buf, received);
	}
}

K_THREAD_DEFINE(thread_udp_config_rx, CONFIG_GATEWAY_UDP_STACK, udp_config_rx_thread, NULL, NULL,
		NULL, CONFIG_GATEWAY_UDP_PRIORITY, 0, 0);
```
