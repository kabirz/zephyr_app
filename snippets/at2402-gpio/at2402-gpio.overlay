#include <zephyr/dt-bindings/i2c/i2c.h>
#include <zephyr/dt-bindings/gpio/gpio.h>

/ {
	gpio_i2c {
		compatible = "gpio-i2c";
		scl-gpios = <&gpiob 8 GPIO_OPEN_DRAIN>;
		sda-gpios = <&gpiob 9 GPIO_OPEN_DRAIN>;
		clock-frequency = <I2C_BITRATE_STANDARD>;
		#address-cells = <1>;
		#size-cells = <0>;

		eeprom0: eeprom@50 {
			compatible = "atmel,at24";
			reg = <0x50>;
			size = <256>;
			pagesize = <8>;
			address-width = <8>;
			timeout = <5>;
		};
	};
};

