## applications/nrf24l01p_demo/Kconfig
```kconfig
mainmenu "nRF24L01P Demo"

choice NRF24L01P_DEMO_ROLE
	prompt "nRF24L01P demo role"
	default NRF24L01P_DEMO_ROLE_TX

config NRF24L01P_DEMO_ROLE_TX
	bool "Transmitter"

config NRF24L01P_DEMO_ROLE_RX
	bool "Receiver"
endchoice

source "Kconfig.zephyr"
```

## boards/apollo_h743ii/Kconfig.defconfig
```kconfig
# STM32H743II Nucleo board configuration

if BOARD_APOLLO_H743II

if NETWORKING

config NET_L2_ETHERNET
	default y

endif # NETWORKING

endif # BOARD_APOLLO_H743II
```

## boards/apollo_h743ii/apollo_h743ii_defconfig
```kconfig
# SPDX-License-Identifier: Apache-2.0

# Enable MPU
CONFIG_ARM_MPU=y

# Enable HW stack protection
CONFIG_HW_STACK_PROTECTION=y

# Enable UART
CONFIG_SERIAL=y

# Enable flash
CONFIG_FLASH=y

# enable flash map
CONFIG_FLASH_MAP=y

# Console
CONFIG_CONSOLE=y
CONFIG_UART_CONSOLE=y

# Enable GPIO
CONFIG_GPIO=y

# rtc
CONFIG_RTC=y
```

## boards/apollo_h743ii/board.yml
```yaml
board:
  name: apollo_h743ii
  full_name: Apollo H743ii
  vendor: st
  socs:
    - name: stm32h743xx
```

## boards/can_f103_rct6/board.yml
```yaml
board:
  name: can_f103rct6
  full_name: can f103rct6
  vendor: st
  socs:
    - name: stm32f103xe
```

## boards/daq_f407vet6/Kconfig.defconfig
```kconfig
# daq_f407vet6 board configuration


if BOARD_DAQ_F407VET6

config SPI_STM32_INTERRUPT
	default y
	depends on SPI

endif # BOARD_DAQ_F407VET6
```

## boards/daq_f407vet6/board.yml
```yaml
board:
  name: daq_f407vet6
  full_name: daq STM32 F407VET6 data collect board
  vendor: others
  socs:
    - name: stm32f407xx
```

## boards/f407vet6/board.yml
```yaml
board:
  name: f407vet6
  full_name: STM32 F407VET6 data collect board
  vendor: others
  socs:
    - name: stm32f407xx
      variants:
      - name: "daq"
      - name: "monv"
```

## boards/laser_stm32f103ret7/board.yml
```yaml
board:
  name: laser_stm32f103ret7
  full_name: laser stm32f103ret7
  vendor: st
  socs:
    - name: stm32f103xe
```

## boards/lora_f103rct6/board.yml
```yaml
board:
  name: lora_f103rct6
  full_name: lora f103rct6
  vendor: st
  socs:
    - name: stm32f103xe
```

## boards/monv_f407vet6/Kconfig.defconfig
```kconfig
# daq_f407vet6 board configuration


if BOARD_MONV_F407VET6

config SPI_STM32_INTERRUPT
	default y
	depends on SPI

endif # BOARD_MONV_F407VET6
```

## boards/monv_f407vet6/board.yml
```yaml
board:
  name: monv_f407vet6
  full_name: monv STM32 F407VET6 data collect board
  vendor: others
  socs:
    - name: stm32f407xx
```

## boards/stm32f103_bluepill/Kconfig.stm32f103_bluepill
```kconfig
# Copyright (c) 2024 Kabirz
# SPDX-License-Identifier: Apache-2.0

config BOARD_STM32F103_BLUEPILL
	select SOC_STM32F103X8
```

## boards/stm32f103_bluepill/board.yml
```yaml
board:
  name: stm32f103_bluepill
  full_name: stm32f103 bluepill
  vendor: st
  socs:
    - name: stm32f103xb
```

## boards/stm32f103_bluepill/stm32f103_bluepill_defconfig
```kconfig
# SPDX-License-Identifier: Apache-2.0

# Enable UART
CONFIG_SERIAL=y

# Console
CONFIG_CONSOLE=y
CONFIG_UART_CONSOLE=y

# enable GPIO
CONFIG_GPIO=y

#  RTT
CONFIG_USE_SEGGER_RTT=y

# RTT shell 
CONFIG_SHELL=y
CONFIG_SHELL_BACKEND_RTT=y
CONFIG_SHELL_BACKEND_SERIAL=y
CONFIG_SHELL_VT100_COLORS=y
CONFIG_SHELL_TAB=y
CONFIG_SHELL_VT100_COMMANDS=y
```

## boards/stm32f407/Kconfig.defconfig
```kconfig
# board configuration

if BOARD_STM32F407

config SPI_STM32_INTERRUPT
	default y
	depends on SPI

ZEPHYR_USER := zephyr,user
config ETH_RESET_ENABLE
	bool "enable ethernet reset"
	default y if $(dt_node_has_prop,/$(ZEPHYR_USER),ethreset-gpios)
endif # BOARD_STM32F407
```

## boards/stm32f407/Kconfig.stm32f407
```kconfig
config BOARD_STM32F407
	select SOC_STM32F407XE if BOARD_STM32F407_STM32F407XX_MONV || BOARD_STM32F407_STM32F407XX_DAQ
	select SOC_STM32F407XG if BOARD_STM32F407_STM32F407XX_XINXIN
	select REBOOT
```

## boards/stm32f407/board.yml
```yaml
board:
  name: stm32f407
  full_name: STM32 F407 board
  vendor: others
  socs:
    - name: stm32f407xx
      variants:
      - name: "daq"
      - name: "monv"
      - name: "xinxin"
```

## boards/stm32f407/stm32f407_xinxin_defconfig
```kconfig
# SPDX-License-Identifier: Apache-2.0

# Enable MPU
CONFIG_ARM_MPU=y

# Enable HW stack protection
CONFIG_HW_STACK_PROTECTION=y

# Enable UART
CONFIG_SERIAL=y

# Console
CONFIG_CONSOLE=y
CONFIG_UART_CONSOLE=y

# Enable GPIO
CONFIG_GPIO=y

# Enable flash
CONFIG_FLASH=y
CONFIG_SPI_NOR_SFDP_MINIMAL=n
CONFIG_SPI_NOR_FLASH_LAYOUT_PAGE_SIZE=4096

# enable flash map
CONFIG_FLASH_MAP=y

# rtc
CONFIG_RTC=y

# ethernet
CONFIG_NET_L2_ETHERNET=y
CONFIG_NETWORKING=y

# memc
CONFIG_MEMC=y
CONFIG_DISPLAY=y
CONFIG_MIPI_DBI=y
```

## drivers/Kconfig
```kconfig
menu "Custom Device Drivers"

rsource "flash/Kconfig"
rsource "nrf24l01p/Kconfig"

endmenu
```

## drivers/flash/Kconfig
```kconfig
config FLASH_FS
	bool "access file use flash api"
	depends on FLASH
	depends on FILE_SYSTEM_LITTLEFS || FAT_FILESYSTEM_ELM
	help
	  access file use flash api

config SPI_NOR_INIT_PRIORITY
	int "Init priority"
	depends on FLASH_FS
	default 80
	help
	  Device driver initialization priority.
```
