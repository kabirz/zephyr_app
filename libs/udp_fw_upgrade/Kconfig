## libs/udp_fw_upgrade/Kconfig
```kconfig
# SPDX-License-Identifier: Apache-2.0

config UDP_FW_UPGRADE
	bool "UDP firmware upgrade support"
	default n
	depends on NET_SOCKETS && FLASH && IMG_MANAGER && NET_MGMT_EVENT
	help
	  Enable UDP-based firmware upgrade functionality.
	  The library is self-contained: it creates the config-port UDP
	  socket (binds INADDR_ANY:CONFIG_UDP_FW_CONFIG_PORT), owns the RX
	  thread, handles firmware-upgrade commands (FW_START 0x1 /
	  FW_DATA 0x2 / FW_END 0x3 / GET_VERSION 0x4 / REBOOT 0x5)
	  internally, and forwards all other config commands to
	  an application-registered callback. Apps only register a
	  business-command callback and never touch the config socket.

config UDP_FW_CONFIG_PORT
	int "UDP config port (firmware upgrade + app commands)"
	default 8601
	depends on UDP_FW_UPGRADE
	help
	  UDP port the library binds to for receiving config commands
	  and firmware upgrade requests.

config UDP_FW_RX_STACK_SIZE
	int "UDP FW upgrade RX thread stack size"
	default 1024
	depends on UDP_FW_UPGRADE

config UDP_FW_RX_PRIORITY
	int "UDP FW upgrade RX thread priority"
	default 8
	depends on UDP_FW_UPGRADE

config UDP_FW_INIT_PRIORITY
	int "UDP FW upgrade init priority"
	default 90
	depends on UDP_FW_UPGRADE
	help
	  SYS_INIT priority. Must run after networking is up
	  (NET_L2/NET_MGMT level). The library waits for NET_EVENT_IF_UP
	  internally before binding the socket.
```
