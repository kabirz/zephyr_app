## drivers/nrf24l01p/Kconfig
```kconfig
# Nordic nRF24L01+ radio driver configuration options

config NRF24L01P
	bool "Nordic nRF24L01+ 2.4GHz radio driver"
	default n
	depends on SPI
	help
	  Enable driver for the Nordic nRF24L01+ 2.4GHz transceiver
	  (SPI bus + GPIO interrupt).

config NRF24L01P_INIT_PRIORITY
	int "Init priority"
	default 70
	depends on NRF24L01P
	help
	  nRF24L01P device initialization priority. Must run after the
	  SPI and GPIO controllers (within POST_KERNEL).

config NRF24L01P_POWER_ON_DELAY_MS
	int "Power-on stabilization delay (ms)"
	default 100
	depends on NRF24L01P
	help
	  Delay after asserting the power-gpios before any SPI access, to let
	  the chip complete Power-On-Reset. Only used when the devicetree node
	  has a power-gpios property.

config NRF24L01P_LOG_LEVEL
	int "Log level"
	default 3
	depends on NRF24L01P && LOG
	help
	  0=none 1=err 2=wrn 3=inf 4=dbg.

config NRF24L01P_INT_THREAD_STACK_SIZE
	int "Stack size for interrupt handler"
	default 1024
	depends on NRF24L01P
	help
	  Stack size of the internal thread that drains the RX FIFO and
	  processes TX completion events on IRQ.

config NRF24L01P_INT_THREAD_PRIORITY
	int "Priority of interrupt handler thread"
	default 2
	depends on NRF24L01P
	help
	  Priority of the internal bottom-half thread (cooperative thread;
	  lower value means higher priority).
```

## libs/Kconfig
```kconfig
config HW_TEST
	bool "enable hw test"
	help
	  build same extra code hw test

rsource "can_fw_upgrade/Kconfig"
```

## libs/can_fw_upgrade/Kconfig
```kconfig
# SPDX-License-Identifier: Apache-2.0

config CAN_FW_UPGRADE
	bool "CAN firmware upgrade support"
	default n
	depends on FLASH && IMG_MANAGER
	help
	  Enable CAN-based firmware upgrade functionality.
	  Uses the same protocol as mod_handler:
	  - PLATFORM_RX (0x101): control commands
	  - PLATFORM_TX (0x102): response frames
	  - FW_DATA_RX (0x103): firmware data
```

## west.yml
```yaml
# The west manifest file for Zephyr project.
#

manifest:
  defaults:
    remote: zephyr_site

  remotes:
    - name: zephyr_site
      url-base: https://github.com/zephyrproject-rtos
    - name: kabirz
      url-base: https://github.com/kabirz

  projects:
    - name: zephyr
      revision: v4.2.0
      path: zephyr
      import:
        name-allowlist:
          - hal_stm32
          - zcbor
          - mbedtls
          - cmsis
          - cmsis_6
          - fatfs
          - littlefs
          - segger

    - name: mcuboot
      revision: 27d7a6f1ab9a3a9a37887feb0bea387f9c63ef00
      remote: kabirz
      path: bootloader/mcuboot

  self:
    path: apps
```
